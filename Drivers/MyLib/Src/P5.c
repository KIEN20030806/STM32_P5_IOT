#include "P5.h"

unsigned char dem_hang = 0;
unsigned char buffer_display[3][32][8] = {0};
int MatrixX , MatrixY ;

unsigned char font[][7]=
{
0x00,0x00,0x00,0x00,0x00,0x00,0x00, //  32
0x10,0x38,0x38,0x10,0x10,0x00,0x10, //! 33
0x6C,0x6C,0x48,0x00,0x00,0x00,0x00, //" 34
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0x00,0x00,0x28,0x50,0x00,0x00,0x00, //~ 126
};

const unsigned char icon[7][8] = {
  {0x30,0x36,0x30,0x36,0x30,0x48,0x48,0x30}, //Tem
	{0x00,0x00,0x10,0x28,0x44,0x44,0x44,0x38},	//Hum
	{0x08,0x08,0x41,0x22,0x00,0x22,0x49,0x08},	//Bri
	{0x02,0x18,0x2A,0xC8,0xC8,0x2A,0x18,0x02}, 	//Noise
	{0x30,0x58,0x4E,0x89,0x83,0xA0,0x49,0x36},	//Air
	{0x00,0x42,0x24,0x18,0x18,0x24,0x42,0x00}, 	
	{0x00,0x00,0x02,0x04,0x88,0x50,0x20,0x00},	
};

void scan16S(char so)
{
	switch(so)
	{
		case 0:  Control_P->BSRR = A_RSET | B_RSET | C_RSET | D_RSET; return;
    case 1:  Control_P->BSRR = A_SSET | B_RSET | C_RSET | D_RSET; return;
    case 2:  Control_P->BSRR = A_RSET | B_SSET | C_RSET | D_RSET; return;
    case 3:  Control_P->BSRR = A_SSET | B_SSET | C_RSET | D_RSET; return;
    case 4:  Control_P->BSRR = A_RSET | B_RSET | C_SSET | D_RSET; return;
    case 5:  Control_P->BSRR = A_SSET | B_RSET | C_SSET | D_RSET; return;
    case 6:  Control_P->BSRR = A_RSET | B_SSET | C_SSET | D_RSET; return;
    case 7:  Control_P->BSRR = A_SSET | B_SSET | C_SSET | D_RSET; return;
    case 8:  Control_P->BSRR = A_RSET | B_RSET | C_RSET | D_SSET; return;
    case 9:  Control_P->BSRR = A_SSET | B_RSET | C_RSET | D_SSET; return;
    case 10: Control_P->BSRR = A_RSET | B_SSET | C_RSET | D_SSET; return;
    case 11: Control_P->BSRR = A_SSET | B_SSET | C_RSET | D_SSET; return;
    case 12: Control_P->BSRR = A_RSET | B_RSET | C_SSET | D_SSET; return;
    case 13: Control_P->BSRR = A_SSET | B_RSET | C_SSET | D_SSET; return;
    case 14: Control_P->BSRR = A_RSET | B_SSET | C_SSET | D_SSET; return;
    case 15: Control_P->BSRR = A_SSET | B_SSET | C_SSET | D_SSET; return;
	}
}

void chuyen(unsigned char byte_r1, unsigned char byte_g1, unsigned char byte_b1, 
            unsigned char byte_r2, unsigned char byte_g2, unsigned char byte_b2) 
{
    unsigned char i, mask;

    for (i = 0; i < 8; i++) 
    {
        mask = 0x80 >> i;

        // ╨i?u khi?n cсc chтn R1, G1, B1, R2, G2, B2 b?ng giс tr? c?a byte tuong ?ng
        if (byte_r1 & mask) {
						GPIOA->BSRR = (1 << R1_PIN);  // Set R1_PIN HIGH
				} else {
						GPIOA->BSRR = (1 << (R1_PIN + 16));  // Set R1_PIN LOW
				}

				if (byte_g1 & mask) {
						GPIOA->BSRR = (1 << G1_PIN);  // Set G1_PIN HIGH
				} else {
						GPIOA->BSRR = (1 << (G1_PIN + 16));  // Set G1_PIN LOW
				}

				if (byte_b1 & mask) {
						GPIOA->BSRR = (1 << B1_PIN);  // Set B1_PIN HIGH
				} else {
						GPIOA->BSRR = (1 << (B1_PIN + 16));  // Set B1_PIN LOW
				}

				if (byte_r2 & mask) {
						GPIOA->BSRR = (1 << R2_PIN);  // Set R2_PIN HIGH
				} else {
						GPIOA->BSRR = (1 << (R2_PIN + 16));  // Set R2_PIN LOW
				}

				if (byte_g2 & mask) {
						GPIOA->BSRR = (1 << G2_PIN);  // Set G2_PIN HIGH
				} else {
						GPIOA->BSRR = (1 << (G2_PIN + 16));  // Set G2_PIN LOW
				}

				if (byte_b2 & mask) {
						GPIOA->BSRR = (1 << B2_PIN);  // Set B2_PIN HIGH
				} else {
						GPIOA->BSRR = (1 << (B2_PIN + 16));  // Set B2_PIN LOW
				}
				clk_P->BSRR=(1<<(CLK_PIN+16));
        clk_P->BSRR=(1<<CLK_PIN);
    }
}

void ngatquetled() 
{
    unsigned char i;
		//OE_P->BSRR=(1<<(OE_PIN+16));
    OE_P->BSRR=(1<<OE_PIN);

    // Truy?n d? li?u ra ma tr?n LED
    for (i = 0; i < 8; i++) {
        chuyen(
            buffer_display[0][dem_hang][i], buffer_display[1][dem_hang][i], buffer_display[2][dem_hang][i],
            buffer_display[0][dem_hang + 16][i], buffer_display[1][dem_hang + 16][i], buffer_display[2][dem_hang + 16][i]
        );
    }
		OE_P->BSRR=(1<<(OE_PIN+16));
    scan16S(dem_hang);
    Control_P->BSRR=(1<<(LAT_PIN+16));
    Control_P->BSRR=(1<<LAT_PIN);
    // Tang hрng dang quщt
    dem_hang++;
    if (dem_hang == 16) dem_hang = 0;
}

void Matrix_chonvitri(int x,int y)
{
	MatrixX=x;
	MatrixY=y;
}


void Matrix_setpx(int32_t x,int32_t y,unsigned char color)
{
	if(x>Graphic_x || y>Graphic_y || x<0 || y < 0)return;
	if((color&R_MASK)!=0)buffer_display[0][y][x/8] |= (0x80 >> (x%8)); //set R
	else buffer_display[0][y][x/8] &= ~(0x80 >> (x%8));                //clear R
	
	if((color&G_MASK)!=0)buffer_display[1][y][x/8] |= (0x80 >> (x%8)); //set G
	else buffer_display[1][y][x/8] &= ~(0x80 >> (x%8));                //clear G
	
	if((color&B_MASK)!=0)buffer_display[2][y][x/8] |= (0x80 >> (x%8)); //set B
	else buffer_display[2][y][x/8] &= ~(0x80 >> (x%8));                //clear B
}

void Matrix_guikitu(unsigned char txt,unsigned char color)
{
	 int x,y;
	 for(y=MatrixY;y<7+MatrixY;y++)
	 {
		 for(x=MatrixX;x<6+MatrixX;x++)
		 {
			 if ( (font[txt-32][y-MatrixY] & (0x80>>(x-MatrixX)))  != 0)Matrix_setpx(x,y,color);
			 else Matrix_setpx(x,y,0);
		 }
	 }
	 MatrixX+=6; //sau khi in xong thi tang con tro vi tri len
}



void Matrix_guichuoi(const char *s,unsigned char color)
{
  while(*s)
		{
			Matrix_guikitu(*s,color);
			s++;
		}
}

void Matrix_guichuoi_MAKE_COLOR(unsigned char *s,unsigned char *color)
{
	while(*s)
		{
			Matrix_guikitu(*s,*color);
			s++;color++;
		}
}

void Matrix_showIcon(int32_t x, int32_t y, int32_t k, unsigned char color) {
    int32_t i, j;
    for (i = 0; i < 8; i++) {
        for (j = 0; j < 8; j++) {
            if (icon[k][i] & (0x80 >> j)) {
                Matrix_setpx(x + j, y + i, color);
            } else {
                Matrix_setpx(x + j, y + i, 0); // Clear pixel
            }
        }
    }
}

void Matrix_clearArea(int32_t x, int32_t y, int32_t width, int32_t height) {
    for (int32_t i = y; i < y + height; i++) {
        for (int32_t j = x; j < x + width; j++) {
            Matrix_setpx(j, i, 0); // Clear pixel
        }
    }
}


